## packages/installer/installer_arm32.its
```
/*
 * Copyright (C) 2017, NXP Semiconductor
 *
 */


/dts-v1/;

/ {
	description = "Image file for the QorIQ ARM 32b Linux Kernel";
	#address-cells = <1>;

	images {
		kernel {
			description = "ARM32 Linux kernel";
			data = /incbin/("../../build/qoriq-linux/linux/arm32/zImage");
			type = "kernel";
			arch = "arm";
			os = "linux";
			compression = "none";
			load = <0x80008000>;
			entry = <0x80008000>;
		};

		initrd-installer {
			description = "initrd for dash on arm32";
			data = /incbin/("./ramdiskrfs/ramdisk_rootfs_arm32.ext2.gz");
			type = "ramdisk";
			arch = "arm";
			os = "linux";
			compression = "none";
		};


		ls1021atwr-dtb {
			description = "Flattened Device Tree blob";
			data = /incbin/("../../build/qoriq-linux/linux/arm32/fsl-ls1021a-twr.dtb");
			type = "flat_dt";
			arch = "arm";
			compression = "none";
			load = <0x90000000>;
		};
	};

	configurations {
		default = "ls1021atwr";


		ls1021atwr {
			description = "Boot Linux kernel";
			kernel = "kernel";
			fdt = "ls1021atwr-dtb";
			ramdisk = "initrd-installer";
		};
	};
};
```
